## extras/buildroot/Config.in
```kconfig
config BR2_PACKAGE_OL
	bool "ol"
	help
	  Otus Lisp is a purely* functional dialect of Lisp.
	  Ol implements an extended subset of R7RS Scheme including,
	  but not limited to, some of the SRFI.
	  It is small, embeddable and crossplatform.

	  https://yuriy-chumak.github.io/ol/
```
